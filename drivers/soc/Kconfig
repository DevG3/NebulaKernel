## drivers/soc/Kconfig
```kconfig
# When adding new entries keep the list in alphabetical order

if ARCH_MSM


source "drivers/soc/qcom/Kconfig"

endif # ARCH_MSM
```

## drivers/soc/qcom/Kconfig
```kconfig
# When adding new entries keep the list in alphabetical order

if ARCH_MSM

config MSM_LIMITER
 	bool "MSM Frequency Limiter Driver"
 	default y
 	help
 	  The MSM Frequency Limiter Driver controls max frequency limit for each CPU
 	  to desired value on suspend/resume

config STATE_NOTIFIER
        bool "State Notifier"
	default y
	
source "drivers/soc/qcom/hotplug/Kconfig"	

endif # ARCH_MSM
```

## drivers/soc/qcom/hotplug/Kconfig
```kconfig
# When adding new entries keep the list in alphabetical order

if ARCH_MSM

config MSM_HOTPLUG
	bool "MSM hotplug driver"
	depends on HOTPLUG_CPU
	default y
	help
	  The MSM hotplug driver controls on-/offlining of additional cores based
	  on current cpu load.

config INTELLI_HOTPLUG
	bool "Intelli hotplug driver"
	depends on HOTPLUG_CPU
	default y
	help
	  An intelligent cpu hotplug driver for
	  Low Latency Frequency Transition capable processors.
	  
config BRICKED_HOTPLUG
	bool "Enable kernel based mpdecision"
	depends on MSM_RUN_QUEUE_STATS
	default y
	help
	  This enables kernel based multi core control.
	  (up/down hotplug based on load)	  
	  
config ALUCARD_HOTPLUG
	bool "Enable alucard-hotplug cpu hotplug driver"
	default n
	help
	  Generic Alucard-hotplug cpu hotplug driver for ARM SOCs

+config ZEN_DECISION
 	bool "Zen Decision MPDecision Replacement"
 	depends on SMP && FB
 	default n
	help
 	  MPDecision is a userspace service that does several functions
 	  related to CPU Frequency and CPU Hotplugging. Some of these are:
 	  - Remove cores when screen goes off
 	  - Enable cores when screen goes on
 	  - Raise CPU_MIN_FREQ to a fixed value for a few seconds on input
   
 	  Zen Decision allows some of the MPDecison functions to be delegated
 	  to the kernel. Right now these are
 	  - Remove cores when screen goes off (after a configurable amount of time)
 	  - Enable cores when screen comes on (immediately)
 
 	  Zen Decision assumes the input boost function of MPDecision should be
 	  delegated to somewhere else in the kernel (Such as in CPU-BOOST)
 
 	  Enable this if you'd like the ability to disable MPDecision.
	  
config MAKO_HOTPLUG
        bool "Enable mako-hotplug cpu hotplug driver"
        default n
        help
          Generic Intelli-plug cpu hotplug driver for ARM SOCs	  

config BLU_PLUG
 	bool "Dynamic hotplug driver"
 	depends on HOTPLUG_CPU
 	default n
 	help
 	  The Dynamic hotplug driver automatically online/offline CPUs proportional to system load.
	  
	  
config FAST_HOTPLUG
	bool "Enable fast hotplug"
	default n
	help
	  Kernel based core control.
	  
config THUNDERPLUG_CONTROL
      bool "Enable plugging down/up of cores using powersuspend"
      default n
      help
       This driver uses powersuspend to take down the cpu cores
       on a octa core device. Tuned to work on a quad core device.
       
config MSM_SLEEPER
	bool "CPU hotplug driver"
	default n
	help
	  CPU hotplug driver
       
endif # ARCH_MSM      
```
